## prj.conf
```kconfig
CONFIG_SHELL=y
# Used to hold device in loop at early boot
CONFIG_PLATFORM_SPECIFIC_INIT=y
```

## src/main.c
```c
/*
 * Copyright (c) 2012-2014 Wind River Systems, Inc.
 *
 * SPDX-License-Identifier: Apache-2.0
 */

#include <zephyr/kernel.h>

void main(void)
{
	printk("Hello World! %s\n", CONFIG_BOARD);
}
```
