/*
 * Copyright 2023 Daniel DeGrasse
 *
 * SPDX-License-Identifier: Apache-2.0
 */

/dts-v1/;

#include <zephyr/dt-bindings/gpio/gpio.h>
#include <nxp/nxp_k22fxq512.dtsi>

#include "flexboard-pinctrl.dtsi"
#include "flexboard.dtsi"

/ {
	model = "FlexBoard";
	compatible = "flexboard";
};
