## boards/arm/flexboard/Kconfig.board
```kconfig
# Copyright 2022 Daniel DeGrasse
# SPDX-License-Identifier: Apache-2.0

config BOARD_FLEXBOARD
	bool "Flexboard"
	depends on SOC_SERIES_KINETIS_K2X
	select SOC_PART_NUMBER_MK22FX512VLQ12
```

## boards/arm/flexboard/Kconfig.defconfig
```kconfig
# Copyright 2023 Daniel DeGrasse
# SPDX-License-Identifier: Apache-2.0

if BOARD_FLEXBOARD

config BOARD
	default "flexboard"

config OSC_XTAL0_FREQ
	default 8000000

config MCG_PRDIV0
	default 0x3

config MCG_VDIV0
	default 0xc

config MCG_FCRDIV
	default 0

# Board uses MCUBoot for all application images
config BOOTLOADER_MCUBOOT
	default y if !MCUBOOT

# Board uses custom key file
config MCUBOOT_SIGNATURE_KEY_FILE
	default "flexboard-boot-key.pem"

endif # BOARD_FLEXBOARD
```

## boards/arm/flexboard/flexboard_full_defconfig
```kconfig
#
# Copyright 2023 Daniel DeGrasse <daniel@degrasse.com>
#

#
# SPDX-License-Identifier: Apache-2.0
#

CONFIG_SOC_MK22F12=y
CONFIG_SOC_SERIES_KINETIS_K2X=y
CONFIG_GPIO=y
CONFIG_PINCTRL=y
CONFIG_SERIAL=y
CONFIG_CONSOLE=y
CONFIG_UART_CONSOLE=y
CONFIG_SYS_CLOCK_HW_CYCLES_PER_SEC=72000000
CONFIG_OSC_LOW_POWER=y

# Enable MPU
CONFIG_ARM_MPU=y
CONFIG_HW_STACK_PROTECTION=y
```

## boards/arm/flexeval/Kconfig.board
```kconfig
# Copyright 2022 Daniel DeGrasse
# SPDX-License-Identifier: Apache-2.0

config BOARD_FLEXEVAL
	bool "FlexEval LED Kit"
	depends on SOC_SERIES_KINETIS_K2X
	select SOC_PART_NUMBER_MK22FX512VLQ12
```

## bringup/04_usb_cdc_acm/Kconfig
```kconfig
# Copyright (c) 2019 Nordic Semiconductor ASA
# SPDX-License-Identifier: Apache-2.0

config ENABLE_DEBUG_LOOP
    bool "Enable debug loop at boot"
    default y
    select PLATFORM_SPECIFIC_INIT
    help
      Hold device in loop at platform boot. Can be disabled once
      device is confirmed to be stable.

source "Kconfig.zephyr"
```

## demos/led_matrix/src/led_matrix/Kconfig
```kconfig
module = LED_MATRIX
module-str = led_matrix
source "subsys/logging/Kconfig.template.log_config"
```

## west.yml
```yaml
# The west manifest file for upstream Zephyr.
#
# The per-installation west configuration file, .west/config, sets the
# path to the project containing this file in the [manifest] section's
# "path" variable.
#
# You are free to create your own manifest files and put them in any
# repository you want, to create your own custom Zephyr installations.
# For example, you could create a manifest file in your own out of
# tree application directory, which would pull this zephyr repository
# in as an ordinary project.
#
# You can pass your manifest repositories to west init when creating a
# new Zephyr installation. See the west documentation for more
# information.

manifest:
  defaults:
    remote: upstream

  remotes:
    - name: upstream
      url-base: https://github.com/zephyrproject-rtos
    - name: danieldegrasse
      url-base: https://github.com/danieldegrasse

  #
  # Please add items below based on alphabetical order
  projects:
    - name: hal_nxp
      revision: 4c992b5db0ea6960f910199dd50310d0f7a766c7
      remote: danieldegrasse
      path: modules/hal/nxp
      groups:
        - hal
    - name: cmsis
      revision: 74981bf893e8b10931464b9945e2143d99a3f0a3
      path: modules/hal/cmsis
      groups:
        - hal
    - name: mcuboot
      revision: 9fc844dc7f3f285f0d5c5687f18eb8b60e3bc0ad
      remote: danieldegrasse
      path: bootloader/mcuboot
    - name: lvgl
      revision: 5ab83099854719ed326b6ecb9b09b07b1eee4818
      path: modules/lib/gui/lvgl
      remote: upstream
    - name: mbedtls
      revision: 6e166050075688fd3cf3d0cb3fc34a1c52df2496
      path: modules/crypto/mbedtls
      groups:
        - crypto
    - name: zephyr
      revision: 69346561e3309b8d402a896e4bbe4c8a84b51470
      remote: danieldegrasse
      path: zephyr
      import: false
      west-commands: scripts/west-commands.yml
    - name: zmk
      revision: 74dde25093535517649de6479f0b7aa0d87746e7
      remote: danieldegrasse
      path: apps/zmk
      import: false
      west-commands: app/scripts/west-commands.yml

  self:
    path: apps
```
