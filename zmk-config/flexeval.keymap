/*
 * Copyright 2023 Daniel DeGrasse
 *
 * SPDX-License-Identifier: Apache-2.0
 */

#include <behaviors.dtsi>
#include <dt-bindings/zmk/keys.h>
#include <dt-bindings/zmk/animation.h>

#define DEFAULT 0
#define FUNC 1

/ {
	keymap {
		compatible = "zmk,keymap";

		/* Default layer implements 1-3 key matrix, and function key */
		default_layer {
			bindings = <&kp A &kp NUMBER_1
				&kp CAPS &mo FUNC>;
		};

		/* Function layer implements special keypresses */
		function_layer {
			bindings = <&bootloader &animation ANIMATION_TOGGLE(0)
				&kp SYSTEM_SLEEP &kp NUMBER_0>;
		};
	};
};
